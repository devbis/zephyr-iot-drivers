## lib/soft_uart_console/Kconfig
```kconfig
# SPDX-License-Identifier: Apache-2.0

config IOTDRV_SOFT_UART_CONSOLE
	bool "Transmit printk output over a GPIO software UART"
	depends on GPIO && PRINTK
	depends on DT_HAS_IOTDRV_SOFT_UART_CONSOLE_ENABLED
	default y
	help
	  Route printk and stdout output through a transmit-only, bit-banged UART
	  on the GPIO from the iotdrv,soft-uart-console devicetree node. The TX
	  frame is 8-N-1 and uses the node's current-speed property.
```

## lib/thermostat_core/Kconfig
```kconfig
# SPDX-License-Identifier: Apache-2.0

config IOTDRV_THERMOSTAT_CORE
	bool "Radio-independent thermostat logic"
	help
	  Setpoint, hysteresis and heating demand. The Zigbee and BLE bridges
	  expose this state; it has no dependency on either radio.
```

## lib/tuya_mcu/Kconfig
```kconfig
# SPDX-License-Identifier: Apache-2.0

config IOTDRV_TUYA_MCU
	bool "Tuya MCU serial protocol"
	help
	  Protocol codec and session engine for a Tuya-style host MCU:
	  product info handshake, datapoint reports and commands, network
	  status and time sync. Independent of the transport and of the
	  devices behind it.

if IOTDRV_TUYA_MCU

config IOTDRV_TUYA_MCU_RX_BUF_SIZE
	int "Receive buffer size"
	default 256
	range 32 2048

config IOTDRV_TUYA_MCU_TX_QUEUE_LEN
	int "Number of queued outgoing frames"
	default 8
	range 1 64

config IOTDRV_TUYA_MCU_ACK_TIMEOUT_MS
	int "Time to wait for an acknowledge before resending"
	default 1000

config IOTDRV_TUYA_MCU_MAX_RETRIES
	int "Resends before an unacknowledged frame is dropped"
	default 5

config IOTDRV_TUYA_MCU_TX_GAP_MS
	int "Minimum gap between outgoing frames"
	default 50

config IOTDRV_TUYA_MCU_LINK_TIMEOUT_S
	int "Silence from the MCU after which the link is reported lost"
	default 90

config IOTDRV_TUYA_UART
	bool "Tuya MCU over UART"
	depends on SERIAL
	select UART_INTERRUPT_DRIVEN
	help
	  Binds a UART device to a Tuya MCU session.

endif # IOTDRV_TUYA_MCU
```

## lib/tuya_thermostat/Kconfig
```kconfig
# SPDX-License-Identifier: Apache-2.0

config IOTDRV_TUYA_THERMOSTAT
	bool "Tuya thermostat models"
	depends on IOTDRV_TUYA_MCU
	help
	  The datapoint maps of the 13 floor-heating thermostats of
	  tuya_thermostat_zrd and the conversions between their datapoints and
	  the values of the Zigbee Thermostat cluster, schedules included.
```
