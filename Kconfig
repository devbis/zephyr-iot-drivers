## Kconfig
```kconfig
# SPDX-License-Identifier: Apache-2.0

menu "IoT drivers"

rsource "lib/thermostat_core/Kconfig"
rsource "lib/tuya_mcu/Kconfig"
rsource "lib/tuya_thermostat/Kconfig"
rsource "lib/soft_uart_console/Kconfig"
rsource "drivers/display/*/Kconfig"
rsource "drivers/sensor/*/Kconfig"
rsource "bridge/zigbee/Kconfig"
rsource "bridge/ble/Kconfig"

endmenu
```

## bridge/ble/Kconfig
```kconfig
# SPDX-License-Identifier: Apache-2.0

config IOTDRV_BRIDGE_BLE
	bool "BLE bridge"
	depends on BT
	help
	  Expose the IoT drivers library state over GATT, such as the
	  Environmental Sensing service.
```

## bridge/zigbee/Kconfig
```kconfig
# SPDX-License-Identifier: Apache-2.0

config IOTDRV_BRIDGE_ZIGBEE
	bool "Zigbee bridge"
	depends on ZIGBEE
	help
	  Expose the IoT drivers library state as ZCL clusters, such as
	  Thermostat and Temperature Measurement.
```

## drivers/display/bu9792/Kconfig
```kconfig
# SPDX-License-Identifier: Apache-2.0

config IOTDRV_DISPLAY_BU9792
	bool "BU9792AFUV segment LCD controller"
	depends on I2C
```

## drivers/display/cgdk2/Kconfig
```kconfig
# SPDX-License-Identifier: Apache-2.0

config IOTDRV_DISPLAY_CGDK2
	bool "CGDK2 segment display"
	default y
	depends on DT_HAS_IOTDRV_CGDK2_LCD_ENABLED
	select I2C
	help
	  Segment LCD of the Qingping CGDK2 (ROHM BU9792AFUV controller).
	  Enabled by a "iotdrv,cgdk2-lcd" node in the devicetree.

if IOTDRV_DISPLAY_CGDK2

config IOTDRV_DISPLAY_CGDK2_INIT_PRIORITY
	int "Init priority"
	default 90
	help
	  Must be later than the I2C driver the panel sits on.

endif # IOTDRV_DISPLAY_CGDK2
```

## drivers/display/cgg1/Kconfig
```kconfig
# SPDX-License-Identifier: Apache-2.0

config IOTDRV_DISPLAY_CGG1
	bool "CGG1-M e-paper display"
	default y
	depends on DT_HAS_IOTDRV_CGG1_EPD_ENABLED
	select GPIO
	help
	  E-paper panel of the Qingping CGG1-M, original and 2022 hardware.
	  Enabled by a "iotdrv,cgg1-epd" node in the devicetree.

if IOTDRV_DISPLAY_CGG1

config IOTDRV_DISPLAY_CGG1_INIT_PRIORITY
	int "Init priority"
	default 90
	help
	  Must be later than the GPIO drivers the panel is wired to.

config IOTDRV_DISPLAY_CGG1_BUSY_TIMEOUT_MS
	int "Busy timeout"
	default 3000
	range 100 60000
	help
	  Longest wait for the panel to leave the busy state, per refresh
	  step. A full refresh keeps it busy for about 1.2 s.

endif # IOTDRV_DISPLAY_CGG1
```

## drivers/display/lcd_b14/Kconfig
```kconfig
# SPDX-License-Identifier: Apache-2.0

config IOTDRV_DISPLAY_LCD_B14
	bool "LYWSD03MMC B1.4 segment LCD controller"
	depends on I2C
```

## drivers/display/lywsd03mmc/Kconfig
```kconfig
# SPDX-License-Identifier: Apache-2.0

config IOTDRV_DISPLAY_LYWSD03MMC
	bool "LYWSD03MMC segment display"
	default y
	depends on DT_HAS_IOTDRV_LYWSD03MMC_LCD_ENABLED
	select I2C
	select SERIAL
	help
	  Segment LCD of the Xiaomi LYWSD03MMC, all board revisions. Enabled
	  by a "iotdrv,lywsd03mmc-lcd" node in the devicetree.

if IOTDRV_DISPLAY_LYWSD03MMC

config IOTDRV_DISPLAY_LYWSD03MMC_INIT_PRIORITY
	int "Init priority"
	default 90
	help
	  Must be later than the I2C and UART drivers the panel sits on.

endif # IOTDRV_DISPLAY_LYWSD03MMC
```

## drivers/display/mho_c122/Kconfig
```kconfig
# SPDX-License-Identifier: Apache-2.0

config IOTDRV_DISPLAY_MHO_C122
	bool "MHO-C122 segment display"
	default y
	depends on DT_HAS_IOTDRV_MHO_C122_LCD_ENABLED
	select I2C
	help
	  Segment LCD of the Xiaomi MHO-C122. Enabled by a
	  "iotdrv,mho-c122-lcd" node in the devicetree.

if IOTDRV_DISPLAY_MHO_C122

config IOTDRV_DISPLAY_MHO_C122_INIT_PRIORITY
	int "Init priority"
	default 90
	help
	  Must be later than the I2C driver the panel sits on.

endif # IOTDRV_DISPLAY_MHO_C122
```

## drivers/display/mho_c401/Kconfig
```kconfig
# SPDX-License-Identifier: Apache-2.0

config IOTDRV_DISPLAY_MHO_C401
	bool "MHO-C401 e-paper display"
	default y
	depends on DT_HAS_IOTDRV_MHO_C401_EPD_ENABLED
	select GPIO
	help
	  E-paper panel of the Xiaomi MHO-C401, both hardware variants.
	  Enabled by a "iotdrv,mho-c401-epd" node in the devicetree.

if IOTDRV_DISPLAY_MHO_C401

config IOTDRV_DISPLAY_MHO_C401_INIT_PRIORITY
	int "Init priority"
	default 90
	help
	  Must be later than the GPIO drivers the panel lines sit on.

endif # IOTDRV_DISPLAY_MHO_C401
```

## drivers/display/mjwsd05mmc/Kconfig
```kconfig
# SPDX-License-Identifier: Apache-2.0

config IOTDRV_DISPLAY_MJWSD05MMC
	bool "MJWSD05MMC segment display"
	default y
	depends on DT_HAS_IOTDRV_MJWSD05MMC_LCD_ENABLED
	select I2C
	help
	  Segment LCD of the Xiaomi MJWSD05MMC (ROHM BU9792AFUV controller).
	  Enabled by a "iotdrv,mjwsd05mmc-lcd" node in the devicetree.

if IOTDRV_DISPLAY_MJWSD05MMC

config IOTDRV_DISPLAY_MJWSD05MMC_INIT_PRIORITY
	int "Init priority"
	default 90
	help
	  Must be later than the I2C driver the panel sits on.

endif # IOTDRV_DISPLAY_MJWSD05MMC
```

## drivers/sensor/bl0937/Kconfig
```kconfig
# SPDX-License-Identifier: Apache-2.0

config IOTDRV_SENSOR_BL0937
	bool "BL0937 energy metering IC (CF/CF1 pulses)"
	default y
	depends on DT_HAS_BELLING_BL0937_ENABLED
	select GPIO
	select SENSOR
	help
	  Voltage, current, active power and accumulated energy from a BL0937,
	  measured by counting its CF and CF1 pulses on GPIO interrupts. Enabled
	  by a "belling,bl0937" node in the devicetree.

if IOTDRV_SENSOR_BL0937

config IOTDRV_SENSOR_BL0937_WINDOW_MS
	int "Measurement window"
	default 1000
	range 200 10000
	help
	  Pulses are counted over this time. CF1 alternates between current and
	  voltage every second window, so each of them is refreshed every four
	  windows. Longer windows give better resolution at low power.

config IOTDRV_SENSOR_BL0937_TIMER_COUNT
	bool "Count the pulses with the SoC timers"
	default y
	depends on SOC_SERIES_TLSR825X
	help
	  Counting every CF and CF1 edge in a GPIO interrupt loses most of them above a few
	  hundred pulses per second (the pending bit of the interrupt is one for all the edges
	  that arrive before it is served), and CF1 gives 1.8 kHz at 230 V. The TLSR8258 timers
	  have a GPIO trigger mode that counts the edges of a pin in hardware: Timer0 counts CF
	  and Timer2 counts CF1 here (Timer1 belongs to the SoC's sleep code). The window then
	  reads the two ticks. Without it the pulses are counted in GPIO interrupts.

endif # IOTDRV_SENSOR_BL0937
```

## drivers/sensor/bl0942/Kconfig
```kconfig
# SPDX-License-Identifier: Apache-2.0

config IOTDRV_SENSOR_BL0942
	bool "BL0942 energy metering IC (UART)"
	default y
	depends on DT_HAS_BELLING_BL0942_ENABLED
	select SERIAL
	select SENSOR
	help
	  Voltage, current, active power, mains frequency and accumulated
	  energy from a BL0942 on a UART. Enabled by a "belling,bl0942" node
	  under the UART node.

if IOTDRV_SENSOR_BL0942

config IOTDRV_SENSOR_BL0942_RX_TIMEOUT_MS
	int "Response timeout"
	default 150
	range 30 2000
	help
	  Longest wait for the 23-byte answer in sensor_sample_fetch(). It
	  takes about 50 ms at the chip's default 4800 baud.

endif # IOTDRV_SENSOR_BL0942
```

## drivers/sensor/cht8305/Kconfig
```kconfig
# SPDX-License-Identifier: Apache-2.0

config IOTDRV_SENSOR_CHT8305
	bool "CHT8305 temperature and humidity sensor"
	default y
	depends on DT_HAS_SENSYLINK_CHT8305_ENABLED
	select I2C
	select SENSOR
	help
	  Sensylink CHT8305 (not the CHT8315, which has its own driver in Zephyr):
	  ambient temperature and relative humidity over I2C. Enabled by a
	  "sensylink,cht8305" node in the devicetree.

if IOTDRV_SENSOR_CHT8305

config IOTDRV_SENSOR_CHT8305_INIT_PRIORITY
	int "Init priority"
	default 90
	help
	  Must be later than the I2C driver the sensor sits on.

endif # IOTDRV_SENSOR_CHT8305
```

## dts/bindings/display/iotdrv,cgdk2-lcd.yaml
```yaml
# SPDX-License-Identifier: Apache-2.0

description: |
  Segment LCD of the Qingping CGDK2, driven by a ROHM BU9792AFUV controller
  at I2C address 0x3E (CGDK2_I2C_ADDR in ATC_MiThermometer). The driver
  probes that address at boot and fails with -ENODEV when nothing answers.

  Example:

    lcd {
        compatible = "iotdrv,cgdk2-lcd";
        i2c = <&i2c0>;
    };

compatible: "iotdrv,cgdk2-lcd"

include: base.yaml

properties:
  i2c:
    type: phandle
    required: true
    description: I2C bus the controller (address 0x3E) sits on
```

## dts/bindings/display/iotdrv,cgg1-epd.yaml
```yaml
# SPDX-License-Identifier: Apache-2.0

description: |
  E-paper panel of the Qingping CGG1-M thermometer, driven over a bit-banged
  9-bit serial link: a command/data bit followed by eight data bits, MSB
  first, clocked by `clk-gpios` while `cs-gpios` is asserted.

  Two hardware generations exist: the original (2020, 2021) and the 2022
  one. They differ in the segment map, the frame size and the controller
  command sequence, and cannot be told apart at run time, so `variant`
  selects one.

  The ATC firmware idles the lines as follows, which the flags below express:
  chip select high, clock low, reset high and busy high when the panel is
  ready. Example (the original CGG1-M, pins as in the ATC firmware):

    lcd {
        compatible = "iotdrv,cgg1-epd";
        variant = "cgg1";
        cs-gpios = <&gpiod 2 GPIO_ACTIVE_LOW>;
        clk-gpios = <&gpiod 7 GPIO_ACTIVE_HIGH>;
        mosi-gpios = <&gpiob 7 GPIO_ACTIVE_HIGH>;
        reset-gpios = <&gpioa 0 GPIO_ACTIVE_LOW>;
        busy-gpios = <&gpiod 4 GPIO_ACTIVE_LOW>;
        enable-gpios = <&gpioa 1 GPIO_ACTIVE_HIGH>;
    };

compatible: "iotdrv,cgg1-epd"

include: base.yaml

properties:
  variant:
    type: string
    required: true
    enum:
      - "cgg1"
      - "cgg1-2022"
    description: |
      Hardware generation: "cgg1" for the 2020 and 2021 boards, "cgg1-2022"
      for the 2022 one (ATC DEVICE_CGG1_ver = 2022, epd_cgg1n.c).

  cs-gpios:
    type: phandle-array
    required: true
    description: Chip select (EPD_CSB), asserted low.

  clk-gpios:
    type: phandle-array
    required: true
    description: Serial clock (EPD_SCL), idles low, data is sampled on the rising edge.

  mosi-gpios:
    type: phandle-array
    required: true
    description: Serial data out (EPD_SDA).

  reset-gpios:
    type: phandle-array
    required: true
    description: Controller reset (EPD_RST), asserted low.

  busy-gpios:
    type: phandle-array
    required: true
    description: Busy input (EPD_BUSY), asserted (busy) low.

  enable-gpios:
    type: phandle-array
    description: |
      Optional power enable (EPD_SHD). The ATC firmware leaves it as a pulled-up
      input; the driver drives it active when given.
```

## dts/bindings/display/iotdrv,lywsd03mmc-lcd.yaml
```yaml
# SPDX-License-Identifier: Apache-2.0

description: |
  Segment LCD of the Xiaomi LYWSD03MMC. The board revision is detected at
  boot: the I2C controllers (B1.4, B1.7, B2.0 and B1.9) are probed on the
  `i2c` bus, and the UART panel (B1.6) is used when no I2C controller answers
  and `uart` is given. Give both when the revision is not known in advance.

  The UART panel is driven at 38400 baud, 8N1, transmit only: set
  `current-speed = <38400>` on that UART node and route its TX pin to the panel.

  Example:

    lcd {
        compatible = "iotdrv,lywsd03mmc-lcd";
        i2c = <&i2c0>;
    };

compatible: "iotdrv,lywsd03mmc-lcd"

include: base.yaml

properties:
  i2c:
    type: phandle
    description: I2C bus of the I2C panel revisions

  uart:
    type: phandle
    description: UART of the B1.6 panel revision
```

## dts/bindings/display/iotdrv,mho-c122-lcd.yaml
```yaml
# SPDX-License-Identifier: Apache-2.0

description: |
  Segment LCD of the Xiaomi MHO-C122. Its controller sits at I2C address
  0x3C (B14_I2C_ADDR in ATC_MiThermometer) and uses the same init sequence
  and data stream as the LYWSD03MMC revision B1.4. The driver probes that
  address at boot and fails with -ENODEV when nothing answers.

  Example:

    lcd {
        compatible = "iotdrv,mho-c122-lcd";
        i2c = <&i2c0>;
    };

compatible: "iotdrv,mho-c122-lcd"

include: base.yaml

properties:
  i2c:
    type: phandle
    required: true
    description: I2C bus the controller (address 0x3C) sits on
```

## dts/bindings/display/iotdrv,mho-c401-epd.yaml
```yaml
# SPDX-License-Identifier: Apache-2.0

description: |
  E-paper display of the Xiaomi MHO-C401, both hardware variants. The panel is
  driven over a bit-banged 9-bit serial link (a command/data bit, then 8 data
  bits, MSB first, clocked on the rising edge of the clock), so every line is a
  plain GPIO. The two variants use different controllers and segment maps and
  cannot be told apart at runtime: select one with `variant`.

  Pin usage of the vendor firmware, for reference:

    line          mho-c401   mho-c401n
    cs            PD2        PA6
    clk           PD7        PC4
    mosi          PB7        PD2
    reset         PA6        PD7
    busy          PA5        PA5
    enable        PC4        PB7

  Chip select and reset are active low, busy is low while the panel refreshes:
  give the GPIO_ACTIVE_LOW flag for those three, and GPIO_PULL_UP on busy.

  Example:

    lcd {
        compatible = "iotdrv,mho-c401-epd";
        variant = "mho-c401";
        cs-gpios = <&gpiod 2 GPIO_ACTIVE_LOW>;
        clk-gpios = <&gpiod 7 GPIO_ACTIVE_HIGH>;
        mosi-gpios = <&gpiob 7 GPIO_ACTIVE_HIGH>;
        reset-gpios = <&gpioa 6 GPIO_ACTIVE_LOW>;
        busy-gpios = <&gpioa 5 (GPIO_ACTIVE_LOW | GPIO_PULL_UP)>;
        enable-gpios = <&gpioc 4 GPIO_ACTIVE_HIGH>;
    };

compatible: "iotdrv,mho-c401-epd"

include: base.yaml

properties:
  variant:
    type: string
    required: true
    enum:
      - "mho-c401"
      - "mho-c401n"
    description: |
      "mho-c401" is the 2020 panel, "mho-c401n" the 2022 one (device type
      0x0008 in the ATC firmware).

  cs-gpios:
    type: phandle-array
    required: true
    description: Serial link chip select, active low

  clk-gpios:
    type: phandle-array
    required: true
    description: Serial link clock

  mosi-gpios:
    type: phandle-array
    required: true
    description: Serial link data line (EPD_SDA)

  reset-gpios:
    type: phandle-array
    required: true
    description: Controller reset, active low

  busy-gpios:
    type: phandle-array
    required: true
    description: |
      Busy input, asserted (logical 1) while the controller refreshes the
      panel. Give GPIO_ACTIVE_LOW.

  enable-gpios:
    type: phandle-array
    description: |
      Line the vendor firmware only leaves pulled high (EPD_SHD on the
      mho-c401, EPD_RST2 on the mho-c401n). Driven to its active level at init
      when present.
```

## dts/bindings/display/iotdrv,mjwsd05mmc-lcd.yaml
```yaml
# SPDX-License-Identifier: Apache-2.0

description: |
  Segment LCD of the Xiaomi MJWSD05MMC, driven by a ROHM BU9792AFUV
  controller at 7-bit I2C address 0x3E (the address is fixed in the driver).
  The controller is probed at boot and the driver fails with -ENODEV when it
  does not answer. The panel has no other lines the driver controls.

  The panel has four digit groups, a clock, weekday and date fields and
  battery, BLE and smiley symbols. The driver uses the big temperature
  group, the small group at the lower right (for humidity), the clock group,
  the unit, BLE, battery and smiley symbols; the weekday, date and AM/PM
  elements are left blank.

  Example:

    lcd {
        compatible = "iotdrv,mjwsd05mmc-lcd";
        i2c = <&i2c0>;
    };

compatible: "iotdrv,mjwsd05mmc-lcd"

include: base.yaml

properties:
  i2c:
    type: phandle
    required: true
    description: I2C bus the BU9792AFUV controller (address 0x3E) sits on
```

## dts/bindings/misc/iotdrv,soft-uart-console.yaml
```yaml
# SPDX-License-Identifier: Apache-2.0

description: Transmit-only software UART used as a printk/stdout console

compatible: "iotdrv,soft-uart-console"

include: base.yaml

properties:
  gpios:
    type: phandle-array
    required: true
    description: GPIO used as the UART TX output

  current-speed:
    type: int
    required: true
    description: UART baud rate
```
