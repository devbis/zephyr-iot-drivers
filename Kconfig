## dts/bindings/misc/tuya,mcu.yaml
```yaml
# SPDX-License-Identifier: Apache-2.0

description: Tuya-style host MCU on a UART

compatible: "tuya,mcu"

include: base.yaml

properties:
  uart:
    type: phandle
    required: true
    description: UART connected to the MCU
```

## dts/bindings/sensor/belling,bl0937.yaml
```yaml
# SPDX-License-Identifier: Apache-2.0

description: |
  BL0937 single-phase energy metering IC read by counting pulses: CF is
  proportional to active power, CF1 to current or voltage depending on the
  SEL pin. The driver counts both on GPIO interrupts and flips SEL.

  The defaults are the TS011F reference board values.

    meter {
        compatible = "belling,bl0937";
        cf-gpios = <&gpiod 4 GPIO_ACTIVE_HIGH>;
        cf1-gpios = <&gpiod 5 GPIO_ACTIVE_HIGH>;
        sel-gpios = <&gpiod 6 GPIO_ACTIVE_HIGH>;
        sel-high-is-voltage;
    };

compatible: "belling,bl0937"

include: sensor-device.yaml

properties:
  cf-gpios:
    type: phandle-array
    required: true
    description: CF pulse output, counted on its active edge.

  cf1-gpios:
    type: phandle-array
    required: true
    description: CF1 pulse output, counted on its active edge.

  sel-gpios:
    type: phandle-array
    required: true
    description: |
      SEL input of the chip. Which level selects voltage is given by
      `sel-high-is-voltage`.

  sel-high-is-voltage:
    type: boolean
    description: |
      SEL high makes CF1 carry voltage. Leave unset on boards where SEL high
      selects current.

  shunt-micro-ohms:
    type: int
    default: 1000
    description: Current shunt resistance in micro-ohms.

  voltage-divider-milli:
    type: int
    default: 2351000
    description: Voltage divider ratio (mains to chip pin) times 1000.

  cf-pulses-per-kwh:
    type: int
    default: 3200
    description: CF pulses per kilowatt-hour, used for the energy total.

  current-noise-floor-milliamps:
    type: int
    default: 0
    description: Current at or below this is reported as zero.

  voltage-mv-per-mhz:
    type: array
    description: |
      Voltage scale measured on the product: <numerator denominator> of the millivolts per
      millihertz of CF1 in the voltage mode. When it is given, voltage-divider-milli is not
      used for the voltage. Stock firmware of the Zbeacon TS011F: <110 861>
      (5 V at 39.136364 Hz, that is 0.1278 V/Hz: 230 V at 1.8 kHz).

  current-ma-per-mhz:
    type: array
    description: |
      Current scale measured on the product: <numerator denominator> of the milliamperes per
      millihertz of CF1 in the current mode. When it is given, shunt-micro-ohms is not used for
      the current. Zbeacon TS011F: <99 8000> (200 mA at 16.161616 Hz, 12.375 mA/Hz).

  power-mw-per-mhz:
    type: array
    description: |
      Power scale measured on the product: <numerator denominator> of the milliwatts per
      millihertz of CF. When it is given, neither shunt-micro-ohms nor voltage-divider-milli is
      used for the power. Zbeacon TS011F: <436 285> (36 W at 23.532110 Hz, 1.5298 W/Hz).
```

## dts/bindings/sensor/belling,bl0942.yaml
```yaml
# SPDX-License-Identifier: Apache-2.0

description: |
  BL0942 single-phase energy metering IC on a UART (4800 baud by default,
  8N1). The node is a child of the UART node; the baud rate is that node's
  `current-speed`.

  The calibration defaults are the reference values of the Tuya TS011F plug
  (ESPHome bl0942 component), for a 1 mOhm shunt and a 5 x 390 kOhm / 510 Ohm
  voltage divider. Other boards need their own values.

    &uart0 {
        current-speed = <4800>;
        meter: bl0942 {
            compatible = "belling,bl0942";
        };
    };

compatible: "belling,bl0942"

include: [sensor-device.yaml, uart-device.yaml]

properties:
  address:
    type: int
    default: 0
    description: Device address set by the A1/A0 pins, 0..3.

  voltage-counts-per-volt:
    type: int
    default: 15873
    description: V_RMS counts per volt.

  current-counts-per-amp:
    type: int
    default: 251213
    description: I_RMS counts per ampere.

  power-counts-per-watt:
    type: int
    default: 596
    description: WATT counts per watt.

  energy-counts-per-kwh:
    type: int
    default: 3305
    description: CF_CNT counts per kilowatt-hour.
```

## dts/bindings/sensor/sensylink,cht8305.yaml
```yaml
# SPDX-License-Identifier: Apache-2.0

description: |
  Sensylink CHT8305 temperature and humidity sensor on I2C. The address is
  0x40 to 0x43, selected by the ADDR pin. The driver checks the manufacturer
  (0x5959) and device (0x8305) registers, so a node whose chip does not answer
  leaves the device not ready.

    &i2c0 {
        cht8305@40 {
            compatible = "sensylink,cht8305";
            reg = <0x40>;
        };
    };

compatible: "sensylink,cht8305"

include: [sensor-device.yaml, i2c-device.yaml]
```
